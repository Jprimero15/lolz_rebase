## arch/arm/hotplug/Kconfig
```kconfig
config INTELLI_HOTPLUG
        bool "Enable intelli-plug cpu hotplug driver"
        default n
        help
          Generic Intelli-plug cpu hotplug driver for ARM SOCs

config MSM_HOTPLUG
	bool "MSM hotplug driver"
	depends on HOTPLUG_CPU
	default n
	help
	  The MSM hotplug driver controls on-/offlining of additional cores based
	  on current cpu load.

config AUTOSMP
	bool "Multi-core automatic hotplug support"
	depends on SMP && HOTPLUG_CPU
        default y
	help
	  Automatically hotplugs the multiple cpu cores on and off
	  based on cpu load and suspend state

config BRICKED_HOTPLUG
	bool "Enable kernel based mpdecision"
	depends on MSM_RUN_QUEUE_STATS
	default y
	help
	 This enables kernel based multi core control.
	 (up/down hotplug based on load)

config BLU_PLUG
	bool "Dynamic hotplug driver"
	depends on HOTPLUG_CPU
	default n
	help
	  The Dynamic hotplug driver automatically online/offline CPUs proportional to system load.
```

## drivers/cpuidle/Kconfig
```kconfig
config CPU_IDLE
	bool "CPU idle PM support"
	default y if ACPI || PPC_PSERIES
	help
	  CPU idle is a generic framework for supporting software-controlled
	  idle processor power management.  It includes modular cross-platform
	  governors that can be swapped during runtime.

	  If you're using an ACPI-enabled platform, you should say Y here.

config CPU_IDLE_GOV_LADDER
	bool "Ladder idle governor"
	depends on CPU_IDLE
	default y

config CPU_IDLE_GOV_MENU
	bool "Menu idle governor"
	depends on CPU_IDLE && NO_HZ
	default y

config CPU_IDLE_GOV_NULL
	bool "Null idle governor"
	depends on CPU_IDLE
	default y
	help
	  Do not use - except with qct lpm idle driver which neglects governor input.

config ARCH_NEEDS_CPU_IDLE_COUPLED
	def_bool n
```
